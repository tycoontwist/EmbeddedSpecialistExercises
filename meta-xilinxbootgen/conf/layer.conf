## meta-xilinxbootgen/conf/layer.conf
```bitbake
# We have a conf and classes directory, add to BBPATH
BBPATH .= ":${LAYERDIR}"

# We have recipes-* directories, add to BBFILES
BBFILES += "${LAYERDIR}/recipes-*/*/*.bb \
            ${LAYERDIR}/recipes-*/*/*.bbappend"

BBFILE_COLLECTIONS += "meta-xilinxbootgen"
BBFILE_PATTERN_meta-xilinxbootgen = "^${LAYERDIR}/"
BBFILE_PRIORITY_meta-xilinxbootgen = "6"

LAYERDEPENDS_meta-xilinxbootgen = "core"
LAYERSERIES_COMPAT_meta-xilinxbootgen = "scarthgap"
```
